/*
 * SPDX-FileCopyrightText: Copyright 2023 Andreas Sandberg <andreas@sandberg.uk>
 *
 * SPDX-License-Identifier: Apache-2.0
 */

/ {
	chosen {
		zephyr,console = &usart2;
		zephyr,uart-mcumgr = &cdc_acm_uart;
		zephyr,code-partition = &boot_partition;
	};
};

zephyr_udc0: &usbotg_fs {
	status = "okay";

	cdc_acm_uart: cdc_acm_uart {
		compatible = "zephyr,cdc-acm-uart";
	};
};
