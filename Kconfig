## Kconfig
```kconfig
#
# SPDX-FileCopyrightText: Copyright 2023 Andreas Sandberg <andreas@sandberg.uk>
#
# SPDX-License-Identifier: Apache-2.0
#

rsource "drivers/Kconfig"
```

## app/src/Kconfig
```kconfig
#
# SPDX-FileCopyrightText: Copyright 2023-2024 Andreas Sandberg <andreas@sandberg.uk>
#
# SPDX-License-Identifier: Apache-2.0
#

choice
	prompt "Transport"
	default RFCH_TRANSPORT_USB

config RFCH_TRANSPORT_NONE
	bool "None"
	help
	  Disable the radio interface.

config RFCH_TRANSPORT_USB
	bool "USB"
	depends on USB_DEVICE_STACK
	select POLL
	help
	  Enable the USB interface to RF Chameleon.

endchoice

if !RFCH_TRANSPORT_NONE

config RFCH_TRANSPORT_SLAB
	int "Maximum number of entries in transport FIFOs"
	default 64
	help
	  This controls the size of the slab allocator that is used to
	  allocate request and data packets. It effectively controls
	  the Maximum number of request and RX packets that can be in
	  flight at any given time.

config RFCH_TRANSPORT_STACK_SIZE
	int "Request handling thread stack size"
	default 2048
	help
	  Size of the stack used for the request handling thread.

endif

choice
	prompt "Radio"
	default RFCH_BACKEND_CC1101

config RFCH_BACKEND_CC1101
	bool "TI CC1101"
	depends on RFCH_CC1101
	help
	  Texas Instruments CC1101

config RFCH_BACKEND_TEST
	bool "Test radio"
	help
	  Virtual radio used for testing.

endchoice

config STM32_BOOTLOADER
	bool
	depends on SOC_STM32F401XC
	default y
```

## app/sysbuild/mcuboot/boards/rfccc1101.conf
```kconfig
#
# SPDX-FileCopyrightText: Copyright 2023 Andreas Sandberg <andreas@sandberg.uk>
#
# SPDX-License-Identifier: Apache-2.0
#

CONFIG_SINGLE_APPLICATION_SLOT=y
CONFIG_MCUBOOT_INDICATION_LED=y

CONFIG_BOOT_SERIAL_BOOT_MODE=y
CONFIG_BOOT_SHARE_BACKEND_RETENTION=y

CONFIG_MCUBOOT_SERIAL=y
CONFIG_BOOT_SERIAL_CDC_ACM=y
CONFIG_BOOT_SERIAL_ENTRANCE_GPIO=n
```

## boards/arm/rfccc1101/Kconfig.board
```kconfig
#
# SPDX-FileCopyrightText: Copyright 2023 Andreas Sandberg <andreas@sandberg.uk>
#
# SPDX-License-Identifier: Apache-2.0
#

config BOARD_RFCCC1101
	bool "RF Chameleon CC1101 board"
	depends on SOC_STM32F401XC
```

## boards/arm/rfccc1101/Kconfig.defconfig
```kconfig
#
# SPDX-FileCopyrightText: Copyright 2023 Andreas Sandberg <andreas@sandberg.uk>
#
# SPDX-License-Identifier: Apache-2.0
#

if BOARD_RFCCC1101

config BOARD
   default "rfccc1101"

endif
```

## boards/arm/rfccc1101/rfccc1101_defconfig
```kconfig
#
# SPDX-FileCopyrightText: Copyright 2023 Andreas Sandberg <andreas@sandberg.uk>
#
# SPDX-License-Identifier: Apache-2.0
#

CONFIG_SOC_SERIES_STM32F4X=y
CONFIG_SOC_STM32F401XC=y

CONFIG_CLOCK_CONTROL=y
CONFIG_PINCTRL=y

CONFIG_ARM_MPU=y

CONFIG_GPIO=y
CONFIG_SERIAL=y
CONFIG_UART_INTERRUPT_DRIVEN=y

CONFIG_LOG_BACKEND_SWO_FREQ_HZ=2000000
```

## drivers/Kconfig
```kconfig
#
# SPDX-FileCopyrightText: Copyright 2023 Andreas Sandberg <andreas@sandberg.uk>
#
# SPDX-License-Identifier: Apache-2.0
#

menu "Radio Drivers"

module = RFCH_RADIO
module-str = Radio drivers
source "subsys/logging/Kconfig.template.log_config"

rsource "cc1101/Kconfig"

config RFCH_RADIO_INIT_PRIORITY
	int "Radio initialization priority"
	default 90
	help
	  System initialization priority for radio drivers.

endmenu
```

## drivers/cc1101/Kconfig
```kconfig
#
# SPDX-FileCopyrightText: Copyright 2023 Andreas Sandberg <andreas@sandberg.uk>
#
# SPDX-License-Identifier: Apache-2.0
#

config RFCH_CC1101
	bool "CC1101"
	default y
	depends on DT_HAS_TI_CC1101_ENABLED
	depends on SPI
	help
	  Enable CC1101 driver

if RFCH_CC1101

config RFCH_CC1101_MAX_PKT_SIZE
	int "Maximum packet size"
	default 255
	help
	  Maximum packet size. Used to allocate packet buffers.

endif
```

## dts/bindings/ti,cc1101.yaml
```yaml
#
# SPDX-FileCopyrightText: Copyright 2023 Andreas Sandberg <andreas@sandberg.uk>
#
# SPDX-License-Identifier: Apache-2.0
#

description: |
  Driver for the TI CC1101 sub-GHz radio.

compatible: "ti,cc1101"

include: spi-device.yaml

properties:
  gdo0-gpios:
    type: phandle-array
    required: true
    description: |
      GDO0 GPIO signal.

  gdo2-gpios:
    type: phandle-array
    required: true
    description: |
      GDO2 GPIO signal.

  pktlen:
    type: int
    required: true
    description: |
      Length of data payload. This is the maximum length if using
      variable packet length.

  rf_cfg:
    type: uint8-array
    required: true
    description: |
      Configuration registers to be loaded at when initializing the
      chip. These registers will typically be provided by RF
      Studio.

  patable:
    type: uint8-array
    required: false
    description: |
      Power amplifier configuration written to the PATABLE register.
```

## west.yml
```yaml
#
# SPDX-FileCopyrightText: Copyright 2023 Andreas Sandberg <andreas@sandberg.uk>
#
# SPDX-License-Identifier: Apache-2.0
#

manifest:
  version: "0.7"

  self:
    path: rfchameleon

  remotes:
    - name: zephyrproject-rtos
      url-base: https://github.com/zephyrproject-rtos

  projects:
    - name: zephyr
      remote: zephyrproject-rtos
      revision: v3.5.0
      import:
        name-allowlist:
          - cmsis
          - segger
          - hal_nordic
          - hal_stm32
```
